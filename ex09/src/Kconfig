## ex09/src/Kconfig
```kconfig
# SPDX-License-Identifier: GPL-2.0-only

config MYMOUNTS
	bool "/proc/mymounts: list mount points and their names"
	help
	  Create /proc/mymounts, listing each mount point of the reader's
	  mount namespace with its name ("root" for /).

	  Built-in only: it reuses the kernel's /proc/mounts iterator
	  (mounts_op) and other fs/ internals that aren't exported to
	  modules.
```
